## components/blink_led/Kconfig
```kconfig
# 这个 menu 会出现在 "Component settings" 菜单下
menu "Blink LED"

    # 定义一个配置项，前缀 CONFIG_ 会被自动添加
    # 在代码中通过 CONFIG_BLINK_GPIO 访问
    config BLINK_GPIO
        int "Blink GPIO number"
        default 8
        help
            GPIO number (IOxx) to blink on and off the LED.
            Some GPIOs are used for other purposes (flash connections, etc.) and cannot be used to blink.

    config BLINK_PERIOD
        int "Blink period in ms"
        range 10 3600000
        default 1000
        help
            Define the blinking period in milliseconds.

endmenu
```

## components/time_manager/Kconfig
```kconfig
menu "Time Manager - NTP Client"

    config NTP_CLIENT_PRIMARY_SERVER
        string "Primary NTP Server"
        default "ntp1.aliyun.com"
        help
            Primary NTP server hostname or IP address for time synchronization.

    config NTP_CLIENT_SECONDARY_SERVER
        string "Secondary NTP Server"
        default "ntp.sjtu.edu.cn"
        help
            Secondary NTP server hostname or IP address for backup.

    config NTP_CLIENT_TERTIARY_SERVER
        string "Tertiary NTP Server"
        default "cn.pool.ntp.org"
        help
            Tertiary NTP server hostname or IP address for additional backup.

    config NTP_CLIENT_SYNC_TIMEOUT_MS
        int "NTP Sync Timeout (ms)"
        range 1000 60000
        default 10000
        help
            Maximum time to wait for NTP synchronization in milliseconds.

    config NTP_CLIENT_RETRY_COUNT
        int "Maximum Retry Count"
        range 1 20
        default 5
        help
            Maximum number of retry attempts for NTP synchronization.

endmenu
```
